## config/boards/arm/bt60/bt60_defconfig
```kconfig
# SPDX-License-Identifier: MIT

# Enable MPU
CONFIG_ARM_MPU=y

# Enable GPIO & Pin Control
CONFIG_GPIO=y
CONFIG_PINCTRL=y

# Encoder
CONFIG_EC11=y
CONFIG_EC11_TRIGGER_GLOBAL_THREAD=y

CONFIG_USE_DT_CODE_PARTITION=y

CONFIG_MPU_ALLOW_FLASH_WRITE=y
CONFIG_NVS=y
CONFIG_SETTINGS_NVS=y
CONFIG_FLASH=y
CONFIG_FLASH_PAGE_LAYOUT=y
CONFIG_FLASH_MAP=y

CONFIG_SPI=y
CONFIG_ZMK_RGB_UNDERGLOW=y
CONFIG_ZMK_RGB_UNDERGLOW_EXT_POWER=y
CONFIG_ZMK_RGB_UNDERGLOW_ON_START=y
CONFIG_ZMK_RGB_UNDERGLOW_HUE_START=262

# Updated strip config for newer Zephyr/ZMK
CONFIG_LED_STRIP=y

CONFIG_BT_CTLR_TX_PWR_PLUS_8=y
CONFIG_PWM=y
CONFIG_LED_PWM=y
CONFIG_ZMK_BACKLIGHT=y
CONFIG_BUILD_OUTPUT_UF2=y

# Updated BLE experimental flag
CONFIG_ZMK_BLE_EXPERIMENTAL_FEATURES=y

# Fix battery reporting bug with Windows
CONFIG_BT_GATT_ENFORCE_SUBSCRIPTION=n

# Increase debounce for error tolerance
CONFIG_ZMK_KSCAN_DEBOUNCE_PRESS_MS=10
CONFIG_ZMK_KSCAN_DEBOUNCE_RELEASE_MS=10
```
